VERSION "1.1 - Zhongsheng ADC IN1 force 0-50 kN"

NS_ :

BS_:

BU_: ZhongshengADC TSMaster

BO_ 769 Zhongsheng_ADC_IN1_0x301: 8 ZhongshengADC
 SG_ IN1_Force_kN : 7|16@0+ (0.002,0) [0|50] "kN"  TSMaster

CM_ BU_ ZhongshengADC "Zhongsheng Technology 8-channel analog acquisition module; this DBC exposes IN1 only.";
CM_ BO_ 769 "CAN ID 0x301, DLC 8. Only D0-D1 are decoded as IN1; D2-D7 remain in the frame but are intentionally not defined.";
CM_ SG_ 769 IN1_Force_kN "Force calibration: transmitter 0-5 V, ADC raw 0-5000, sensor force 0-50 kN. Physical force = raw * 0.01 kN.";
BA_DEF_  "BusType" STRING ;
BA_DEF_DEF_  "BusType" "CAN";
